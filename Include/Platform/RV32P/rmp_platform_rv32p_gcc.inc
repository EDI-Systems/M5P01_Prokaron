/******************************************************************************
Filename    : rmp_platform_rv32p_gcc.inc
Author      : pry
Date        : 10/04/2012
Description : The assembly part of the RMP RTOS. This is for RV32P, and
              contains macros to be included in all interrupt assembly code
              as needed.
******************************************************************************/

/* Begin Import **************************************************************/
    /* The stack address of current thread */
    .global             RMP_SP_Cur
    /* The interrupt active flag */
    .global             RMP_RV32P_Int_Act
    /* The yield pending flag */
    .global             _RMP_RV32P_Yield_Pend
    /* Save and load extra contexts, such as FPU, peripherals and MPU */
    .global             RMP_Ctx_Save
    .global             RMP_Ctx_Load
    /* Extract highest priority running thread */
    .global             _RMP_Run_High
    /* Handler for MSP430 timer interrupt */
    .global             _RMP_RV32P_Tim_Handler
/* End Import ****************************************************************/

/* Begin Macro ***************************************************************/
    /* Save all GP regs */
    .macro              RMP_RV32P_REG_SAVE
    ADDI                sp,sp,-32*4
    SW                  x31,31*4(sp)
    SW                  x30,30*4(sp)
    SW                  x29,29*4(sp)
    SW                  x28,28*4(sp)
    SW                  x27,27*4(sp)
    SW                  x26,26*4(sp)
    SW                  x25,25*4(sp)
    SW                  x24,24*4(sp)
    SW                  x23,23*4(sp)
    SW                  x22,22*4(sp)
    SW                  x21,21*4(sp)
    SW                  x20,20*4(sp)
    SW                  x19,19*4(sp)
    SW                  x18,18*4(sp)
    SW                  x17,17*4(sp)
    SW                  x16,16*4(sp)
    SW                  x15,15*4(sp)
    SW                  x14,14*4(sp)
    SW                  x13,13*4(sp)
    SW                  x12,12*4(sp)
    SW                  x11,11*4(sp)
    SW                  x10,10*4(sp)
    SW                  x9,9*4(sp)
    SW                  x8,8*4(sp)
    SW                  x7,7*4(sp)
    SW                  x6,6*4(sp)
    SW                  x5,5*4(sp)
    SW                  x4,4*4(sp)
    SW                  x3,3*4(sp)
    SW                  x1,2*4(sp)
    CSRR                a0,mepc
    SW                  a0,1*4(sp)
    CSRR                a0,mstatus
    .endm

    /* Prepare for a context switch */
    .macro              RMP_RV32P_SWITCH_PRE
    SW                  a0,0*4(sp)
    .option             push
    .option             norelax
    LA                  gp,_RMP_Global
    .option             pop
    LA                  a0,RMP_SP_Cur
    SW                  sp,(a0)
    LA                  sp,_RMP_Stack
    LA                  a0,RMP_RV32P_Int_Act
    LI                  a1,1
    SW                  a1,(a0)
    .endm

    /* Finish up the context switch */
    .macro              RMP_RV32P_SWITCH_POST
    LA                  a0,_RMP_RV32P_Yield_Pend
    LW                  a1,(a0)
    BEQZ                a1,1f
    SW                  zero,(a0)
    CALL                _RMP_Run_High
1:
    LA                  a0,RMP_RV32P_Int_Act
    SW                  zero,(a0)
    LA                  a0,RMP_SP_Cur
    LW                  sp,(a0)
    LW                  a0,0*4(sp)
    .endm

    /* Restore all GP regs */
    .macro              RMP_RV32P_REG_RESTORE
    LI                  a1,0x1880
    OR                  a0,a0,a1
    CSRW                mstatus,a0
    LW                  a0,1*4(sp)
    CSRW                mepc,a0
    LW                  x1,2*4(sp)
    LW                  x3,3*4(sp)
    LW                  x4,4*4(sp)
    LW                  x5,5*4(sp)
    LW                  x6,6*4(sp)
    LW                  x7,7*4(sp)
    LW                  x8,8*4(sp)
    LW                  x9,9*4(sp)
    LW                  x10,10*4(sp)
    LW                  x11,11*4(sp)
    LW                  x12,12*4(sp)
    LW                  x13,13*4(sp)
    LW                  x14,14*4(sp)
    LW                  x15,15*4(sp)
    LW                  x16,16*4(sp)
    LW                  x17,17*4(sp)
    LW                  x18,18*4(sp)
    LW                  x19,19*4(sp)
    LW                  x20,20*4(sp)
    LW                  x21,21*4(sp)
    LW                  x22,22*4(sp)
    LW                  x23,23*4(sp)
    LW                  x24,24*4(sp)
    LW                  x25,25*4(sp)
    LW                  x26,26*4(sp)
    LW                  x27,27*4(sp)
    LW                  x28,28*4(sp)
    LW                  x29,29*4(sp)
    LW                  x30,30*4(sp)
    LW                  x31,31*4(sp)
    ADDI                sp,sp,32*4
    MRET
    .endm

    /* Save macro for no coprocessor case */
    .macro              RMP_RV32P_INT_SAVE_NONE
    RMP_RV32P_REG_SAVE
    RMP_RV32P_SWITCH_PRE
    .endm

    /* Load macro for no coprocessor case */
    .macro              RMP_RV32P_INT_RESTORE_NONE
    RMP_RV32P_SWITCH_POST
    RMP_RV32P_REG_RESTORE
    .endm

    /* Save macro for RVF case */
    .macro              RMP_RV32P_INT_SAVE_RVF
    RMP_RV32P_REG_SAVE
    LUI                 a1,4
    AND                 a1,a1,a0
    BEQZ                a1,1f
    ADDI                sp,sp,-33*4
    .hword              0x25F3      /* FRCSR   a1 */
    .hword              0x0030
    SW                  a1,32*4(sp)
    .hword              0xFEFE      /* FSW     f31, 31*4(sp) */
    .hword              0xFCFA      /* FSW     f30, 30*4(sp) */
    .hword              0xFAF6      /* FSW     f29, 29*4(sp) */
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    .hword              0xE002      /* FSW     f0, 0*4(sp) */
1:
    RMP_RV32P_SWITCH_PRE
    .endm

    /* Load macro for RVF case */
    .macro              RMP_RV32P_INT_RESTORE_RVF
    RMP_RV32P_SWITCH_POST
    LUI                 a1,4
    AND                 a1,a1,a0
    BEQZ                a1,1f
    .hword              0x6002      /* FLW     f0, 0*4(sp) */
    .hword              0x6092      /* FLW     f1, 1*4(sp) */
    .hword              0x6122      /* FLW     f2, 2*4(sp) */
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    .hword              0x7FF6      /* FLW     f31, 31*4(sp) */
    LW                  a1,32*4(sp)
    .hword              0x9073      /* FSCSR   a1 */
    .hword              0x0035
    ADDI                sp,sp,33*4
1:
    RMP_RV32P_REG_RESTORE
    .endm

    /* Save macro for RVFD case */
    .macro              RMP_RV32P_INT_SAVE_RVFD
    RMP_RV32P_REG_SAVE
    LUI                 a1,4
    AND                 a1,a1,a0
    BEQZ                a1,1f
    ADDI                sp,sp,-65*4
    .hword              0x25F3      /* FRCSR   a1 */
    .hword              0x0030
    SW                  a1,32*8(sp)
    .hword              0x3C27      /* FSD     f31,31*8(sp) */
    .hword              0x0FF1
    .hword              0x3827      /* FSD     f30,30*8(sp) */
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    .hword              0x0001
1:
    RMP_RV32P_SWITCH_PRE
    .endm

    /* Load macro for RVFD case */
    .macro              RMP_RV32P_INT_RESTORE_RVFD
    RMP_RV32P_SWITCH_POST
    LUI                 a1,4
    AND                 a1,a1,a0
    BEQZ                a1,1f
    .hword              0x3007      /* FLD     f0,0*8(sp) */
    .hword              0x0001
    .hword              0x3087      /* FLD     f1,1*8(sp) */
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    .hword              0x0F81
    LW                  a1,32*8(sp)
    .hword              0x9073      /* FSCSR   a1 */
    .hword              0x0035
    ADDI                sp,sp,65*4
1:
    RMP_RV32P_REG_RESTORE
    .endm
/* End Macro *****************************************************************/

/* End Of File ***************************************************************/

/* Copyright (C) Evo-Devo Instrum. All rights reserved ***********************/
